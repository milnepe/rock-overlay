/dts-v1/;						
/plugin/;						

/* Blue LED overlay for ROCK 3A on Armbian 23.05.0-trunk Bullseye
   with Linux 5.10.110-rk35xx
   
   rk3568-roc-3a.dts fragment:
   
	gpio_leds: gpio-leds {
		compatible = "gpio-leds";
		status = "okay";

		user-led {
			gpios = <&gpio0 RK_PB7 GPIO_ACTIVE_HIGH>;
			linux,default-trigger = "timer";
			default-state = "on";
			pinctrl-0 = <&user_led>;
		};
	
	Compile overlay with:
	dtc -O dtb -o rk3568-blue-led.dtbo rk3568-blue-led.dts
	
	Install in:
	/boot/overlay-user
	
	Set armbianEnv.txt to:
	user_overlays=rk3568-blue-led
	
	Or use armbian-add-overlay to apply the overlay
	sudo armbian-add-overlay rk3568-red-led.dts
	
	Need to disable armbian led scripts as they overwrite dtbo
	sudo systemctl disable armbian-led-state.service
	
	Check overlay loads in serial console:
	...
	reading /overlay-user/rk3568-blue-led.dtbo                                      
	214 bytes read in 2 ms (104.5 KiB/s)                                            
	Applying user provided DT overlay rk3568-blue-led.dtbo
	... 
*/
	




/* Target location syntax works for base DT not compiled with -@
   as is the case with Armbian 
   
   Note: timer does not work in this version
   */

&{/gpio-leds} {				
	user-led {
		linux,default-trigger = "heartbeat";
	};						
};
